#include "oled.h"
#include "esp_log.h"
#include "freertos/FreeRTOS.h"
#include "freertos/task.h"
#include <string.h>

static const char *TAG = "OLED";

#define OLED_I2C_ADDRESS 0x3C // Standardna adresa za SSD1306 OLED

// Osnovne komande za inicijalizaciju SSD1306 ekrana
static const uint8_t oled_init_cmds[] = {
    0xAE,
    0xD5, 0x80,
    0xA8, 0x3F, 
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    0xA6, 
    0xAF  
};

void oled_init(i2c_master_dev_handle_t *dev_handle)
{
    // Konfiguracija I2C
    i2c_master_bus_config_t bus_config = {
        .i2c_port = I2C_NUM_0,
        .sda_io_num = OLED_SDA_PIN,
        .scl_io_num = OLED_SCL_PIN,
        .clk_source = I2C_CLK_SRC_DEFAULT,
        .glitch_ignore_cnt = 7,
        .flags.enable_internal_pullup = true,
    };

    i2c_master_bus_handle_t bus_handle;
    ESP_ERROR_CHECK(i2c_new_master_bus(&bus_config, &bus_handle));

    // Konfiguracija OLED uređaja na magistrali
    i2c_device_config_t dev_config = {
        .dev_addr_length = I2C_ADDR_BIT_LEN_7,
        .device_address = OLED_I2C_ADDRESS,
        .scl_speed_hz = 400000, // 400kHz I2C brzina
    };

    ESP_ERROR_CHECK(i2c_master_bus_add_device(bus_handle, &dev_config, dev_handle));

    // Slanje inicijalizacionih komandi ekranu
    uint8_t buffer[sizeof(oled_init_cmds) + 1];
    buffer[0] = 0x00;
    memcpy(&buffer[1], oled_init_cmds, sizeof(oled_init_cmds));

    ESP_ERROR_CHECK(i2c_master_transmit(*dev_handle, buffer, sizeof(buffer), pdMS_TO_TICKS(1000)));
    ESP_LOGI(TAG, "OLED uspešno inicijalizovan!");
}

void oled_clear(i2c_master_dev_handle_t dev_handle)
{
    // Kreiranje praznog bafera za čišćenje ekrana (128 x 64 piksela = 1024 bajta)
    uint8_t zero_buffer[129];
    zero_buffer[0] = 0x40;
    memset(&zero_buffer[1], 0x00, 128);

    for (int page = 0; page < 8; page++) {
        
        uint8_t set_page_cmds[] = {
            0x00, 
            0xB0 | page,
            0x00,
            0x10  
        };
        i2c_master_transmit(dev_handle, set_page_cmds, sizeof(set_page_cmds), pdMS_TO_TICKS(1000));

        for (int col = 0; col < 128; col += 128) {
            i2c_master_transmit(dev_handle, zero_buffer, 129, pdMS_TO_TICKS(1000));
        }
    }
}

// tabela za karaktere(osnovna 5x7 matrica)
static const uint8_t font5x7[][5] = {
    [' '] = {0x00, 0x00, 0x00, 0x00, 0x00},
    ['!'] = {0x00, 0x00, 0x5F, 0x00, 0x00},
    ['"'] = {0x00, 0x07, 0x00, 0x07, 0x00},
    ['%'] = {0x22, 0x14, 0x08, 0x32, 0x22},
    ['+'] = {0x08, 0x08, 0x3E, 0x08, 0x08},
    ['-'] = {0x08, 0x08, 0x08, 0x08, 0x08},
    ['.'] = {0x00, 0x60, 0x60, 0x00, 0x00},
    ['/'] = {0x20, 0x10, 0x08, 0x04, 0x02},
    ['0'] = {0x3E, 0x51, 0x49, 0x45, 0x3E},
    ['1'] = {0x00, 0x42, 0x7F, 0x40, 0x00},
    ['2'] = {0x42, 0x61, 0x51, 0x49, 0x46},
    ['3'] = {0x21, 0x41, 0x45, 0x4B, 0x31},
    ['4'] = {0x18, 0x14, 0x12, 0x7F, 0x10},
    ['5'] = {0x27, 0x45, 0x45, 0x45, 0x39},
    ['6'] = {0x3C, 0x4A, 0x49, 0x49, 0x30},
    ['7'] = {0x01, 0x71, 0x09, 0x05, 0x03},
    ['8'] = {0x36, 0x49, 0x49, 0x49, 0x36},
    ['9'] = {0x06, 0x49, 0x49, 0x29, 0x1E},
    [':'] = {0x00, 0x36, 0x36, 0x00, 0x00},
    ['>'] = {0x08, 0x14, 0x22, 0x41, 0x00},
    ['A'] = {0x7C, 0x12, 0x11, 0x12, 0x7C},
    ['B'] = {0x7F, 0x49, 0x49, 0x49, 0x36},
    ['C'] = {0x3E, 0x41, 0x41, 0x41, 0x22},
    ['D'] = {0x7F, 0x41, 0x41, 0x22, 0x1C},
    ['E'] = {0x7F, 0x49, 0x49, 0x49, 0x41},
    ['F'] = {0x7F, 0x09, 0x09, 0x09, 0x01},
    ['G'] = {0x3E, 0x41, 0x49, 0x49, 0x7A},
    ['H'] = {0x7F, 0x08, 0x08, 0x08, 0x7F},
    ['I'] = {0x00, 0x41, 0x7F, 0x41, 0x00},
    ['L'] = {0x7F, 0x40, 0x40, 0x40, 0x40},
    ['M'] = {0x7F, 0x02, 0x0C, 0x02, 0x7F},
    ['N'] = {0x7F, 0x04, 0x08, 0x10, 0x7F},
    ['O'] = {0x3E, 0x41, 0x41, 0x41, 0x3E},
    ['P'] = {0x7F, 0x09, 0x09, 0x09, 0x06},
    ['R'] = {0x7F, 0x09, 0x19, 0x29, 0x46},
    ['S'] = {0x26, 0x49, 0x49, 0x49, 0x32},
    ['T'] = {0x01, 0x01, 0x7F, 0x01, 0x01},
    ['V'] = {0x1F, 0x20, 0x40, 0x20, 0x1F},
    ['Z'] = {0x61, 0x51, 0x49, 0x45, 0x43},
    // mala slova mapirana na velika da bi se izbegle greske u prikazu
    ['a'] = {0x7C, 0x12, 0x11, 0x12, 0x7C},
    ['c'] = {0x3E, 0x41, 0x41, 0x41, 0x22},
    ['d'] = {0x7F, 0x41, 0x41, 0x22, 0x1C},
    ['e'] = {0x7F, 0x49, 0x49, 0x49, 0x41},
    ['g'] = {0x3E, 0x41, 0x49, 0x49, 0x7A},
    ['i'] = {0x00, 0x41, 0x7F, 0x41, 0x00},
    ['j'] = {0x40, 0x40, 0x41, 0x3F, 0x00},
    ['k'] = {0x7F, 0x08, 0x14, 0x22, 0x41},
    ['l'] = {0x7F, 0x40, 0x40, 0x40, 0x40},
    ['m'] = {0x7F, 0x04, 0x08, 0x04, 0x7F},
    ['n'] = {0x7F, 0x04, 0x08, 0x10, 0x7F},
    ['o'] = {0x3E, 0x41, 0x41, 0x41, 0x3E},
    ['p'] = {0x7F, 0x09, 0x09, 0x09, 0x06},
    ['r'] = {0x7F, 0x09, 0x19, 0x29, 0x46},
    ['s'] = {0x26, 0x49, 0x49, 0x49, 0x32},
    ['t'] = {0x01, 0x01, 0x7F, 0x01, 0x01},
    ['u'] = {0x3F, 0x40, 0x40, 0x40, 0x3F},
    ['v'] = {0x1F, 0x20, 0x40, 0x20, 0x1F},
    ['z'] = {0x61, 0x51, 0x49, 0x45, 0x43}
};

void oled_display_text(i2c_master_dev_handle_t dev_handle, int line, const char *text)
{
    if (line < 0 || line > 7) return;

    
    uint8_t set_page_cmds[] = {
        0x00,
        0xB0 | line,
        0x00,
        0x10
    };
    i2c_master_transmit(dev_handle, set_page_cmds, sizeof(set_page_cmds), pdMS_TO_TICKS(1000));

    int len = strlen(text);
    uint8_t data_buf[128];
    data_buf[0] = 0x40; 

    int cursor = 1;
    for (int i = 0; i < len && cursor < 123; i++) {
        unsigned char c = text[i];
        
        // Automatska konverzija naših č/ć/š/đ karaktera u obična slova da ne pukne ispis
        if (c == 0xC4 || c == 0xC5 || c == 0xC3) { // UTF-8 prefiksi za naša slova
            i++; // Preskoči drugi bajt UTF-8 karaktera
            c = 'c'; // Zamena po potrebi
        }

        const uint8_t *glyph = font5x7[(int)c];
        if (!glyph) {
            glyph = font5x7['?']; 
        }

        for (int j = 0; j < 5; j++) {
            data_buf[cursor++] = glyph[j];
        }
        data_buf[cursor++] = 0x00; 
    }

    while (cursor < 128) {
        data_buf[cursor++] = 0x00;
    }

    i2c_master_transmit(dev_handle, data_buf, 128, pdMS_TO_TICKS(1000));
}